## Kconfig
```kconfig
menu "VideoSDK IoT SDK"

choice AUDIO_BOARD
    prompt "Audio hardware board"
    default ESP32S3_XIAO
    help
        Select the ESP32-S3 board this component's prebuilt library is linked
        for. The choice picks which prebuilt archive is used:
          - ESP32-S3-Korvo-2 -> libiot-sdk-korvov2.a (full-duplex A/V)
          - ESP32-S3-XIAO     -> libiot-sdk-xiao.a    (audio + video SEND only)

config ESP32_S3_KORVO_2_V3_0_BOARD
    bool "ESP32-S3-Korvo-2"
    depends on IDF_TARGET_ESP32S3
config ESP32S3_XIAO
    bool "ESP32-S3-XIAO"
endchoice

endmenu
```

## Kconfig.projbuild
```kconfig
menu "SET Microcontroller"

choice AUDIO_BOARD
    prompt "Audio hardware board"
    default ESP32S3_XIAO
    help
        Select an audio board to use

config ESP32_S3_KORVO_2_V3_0_BOARD
    bool "ESP32-S3-Korvo-2"
    depends on IDF_TARGET_ESP32S3
config ESP32S3_XIAO
    bool "ESP32-S3-XIAO"
endchoice

config SPEAKER_VOLUME
    int "Speaker output volume (0-100)"
    range 0 100
    default 100
    depends on ESP32_S3_KORVO_2_V3_0_BOARD
    help
        Starting playback volume, in percent. Only boards with a speaker
        (Korvo-2) use this. You can change it at runtime by calling
        setSpeakerVolume() from your app.

endmenu

menu "VideoSDK Configuration"

config VIDEOSDK_TOKEN
    string "Auth token (JWT)"
    default ""
    help
        Your VideoSDK JWT token from https://app.videosdk.live.
        Required to join a room. Do NOT commit a real token to a
        public repository -- set it here via 'idf.py menuconfig' (it is
        stored in sdkconfig, not in source).

config VIDEOSDK_ROOM_ID
    string "Room ID"
    default ""
    help
        The room ID to join, e.g. "abcd-efgh-ijkl". Create one
        from your VideoSDK dashboard or the create_room() API.

endmenu

menu "VideoSDK Logging"

choice VIDEOSDK_LOG_MODE
    prompt "Log verbosity"
    default VIDEOSDK_LOG_MODE_NORMAL
    help
        How much the SDK prints. NORMAL shows the session lifecycle plus
        warnings and errors; DEBUG adds the periodic heartbeats and
        diagnostics. Read this in your app and pass it to
        videosdk_set_log_mode() before init() (see the README).

        DEBUG also adds video-receive diagnostics to the log.

config VIDEOSDK_LOG_MODE_NORMAL
    bool "Normal (lifecycle, warnings, errors)"
config VIDEOSDK_LOG_MODE_DEBUG
    bool "Debug (adds heartbeats and diagnostics)"
endchoice

endmenu
```

## examples/audio_call/main/Kconfig.projbuild
```kconfig
menu "VideoSDK Configuration"

config VIDEOSDK_TOKEN
    string "Auth token (JWT)"
    default ""
    help
        Your VideoSDK JWT token from https://app.videosdk.live.
        Required to join a meeting. Do NOT commit a real token to a
        public repository -- set it here via 'idf.py menuconfig' (it is
        stored in sdkconfig, not in source).

config VIDEOSDK_MEETING_ID
    string "Meeting / room ID"
    default ""
    help
        The meeting (room) ID to join, e.g. "abcd-efgh-ijkl". Create one
        from your VideoSDK dashboard or the create_meeting() API.

config SPEAKER_VOLUME
    int "Speaker output volume (0-100)"
    range 0 100
    default 100
    depends on ESP32_S3_KORVO_2_V3_0_BOARD
    help
        Initial ES8311 speaker volume (percent), Korvo-2 only. NOTE: with the
        prebuilt library this value is fixed at library build time -- to change
        volume in your app, call the runtime setSpeakerVolume() API instead.

endmenu
```
